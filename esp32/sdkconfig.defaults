## esp32/sdkconfig.defaults
```kconfig
CONFIG_SPIRAM_SUPPORT=y
CONFIG_SPIRAM_USE_MALLOC=y
#CONFIG_SPIRAM_USE_CAPS_ALLOC=y
CONFIG_ESP32_DEFAULT_CPU_FREQ_240=y
CONFIG_SPIRAM_CACHE_WORKAROUND=y
CONFIG_SPIRAM_ALLOW_STACK_EXTERNAL_MEMORY=y
CONFIG_ESP_INT_WDT_TIMEOUT_MS=10000
```
